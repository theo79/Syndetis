## main/Kconfig.projbuild
```kconfig
menu "Syndetis AutoTest"
    config SYNDETIS_AUTOTEST_DNS_HOSTNAME
        string "Optional site-local DNS test hostname (empty disables resolution)"
        default ""
        help
            Set only a hostname provided by the local site if DNS resolution
            should be tested. There is no default hostname or Internet target.
            An empty value checks DNS configuration and skips resolution.
endmenu
```

## sdkconfig.defaults
```kconfig
CONFIG_IDF_TARGET="esp32"
CONFIG_ESPTOOLPY_FLASHSIZE_4MB=y
CONFIG_FREERTOS_HZ=1000
CONFIG_ETH_USE_ESP32_EMAC=y
CONFIG_ESP_WIFI_ENABLED=y
# CONFIG_LWIP_IP_FORWARD is not set
# CONFIG_LWIP_IPV6 is not set

# CONFIG_LWIP_AUTOIP is not set
# CONFIG_LWIP_DHCP_RESTORE_LAST_IP is not set

CONFIG_PARTITION_TABLE_CUSTOM=y
CONFIG_PARTITION_TABLE_CUSTOM_FILENAME="partitions.csv"
CONFIG_BOOTLOADER_APP_ROLLBACK_ENABLE=y
CONFIG_ESP_HTTPS_SERVER_ENABLE=y
# CONFIG_ESP_HTTPS_SERVER_EVENTS is not set
```
